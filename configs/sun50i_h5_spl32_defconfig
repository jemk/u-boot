## configs/sun50i_h5_spl32_defconfig
```kconfig
CONFIG_ARM=y
CONFIG_ARCH_SUNXI=y
CONFIG_MACH_SUN50I_H5_32=y
CONFIG_DRAM_CLK=672
CONFIG_DRAM_ZQ=3881977
CONFIG_DRAM_ODT_EN=y
# CONFIG_FIT is not set
CONFIG_SPL=y
CONFIG_DEFAULT_DEVICE_TREE="sun50i-h5-orangepi-pc2"
# CONFIG_SPL_LOAD_FIT is not set
# CONFIG_SPL_OF_LIBFDT is not set
# CONFIG_SPL_SPI_SUNXI is not set
# CONFIG_CMD_IMLS is not set
# CONFIG_CMD_FLASH is not set
# CONFIG_CMD_FPGA is not set
```
